## Config.in
```kconfig
menu "platinum applications"
source "../vendor/amlogic/external/platinum/upnp-app/Config.in"
source "../vendor/amlogic/external/platinum/netcheck/Config.in"
endmenu
```

## netcheck/Config.in
```kconfig
config BR2_PACKAGE_NETCHECK
    bool "upnp-net-check"
    depends on BR2_PACKAGE_UPNP_APP
    help
        dlna net check.
```
